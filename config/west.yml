## config/west.yml
```yaml
manifest:
  remotes:
    - name: zmkfirmware
      url-base: https://github.com/zmkfirmware
    - name: krikun98
      url-base: https://github.com/krikun98
    - name: petejohanson
      url-base: https://github.com/petejohanson
    # Additional modules containing boards/shields/custom code can be listed here as well
    # See https://docs.zephyrproject.org/3.2.0/develop/west/manifest.html#projects
  projects:
    - name: zmk
      # remote: zmkfirmware
      # revision: main
      # https://github.com/zmkfirmware/zmk/pull/2027
      remote: petejohanson
      revision: feat/pointers-move-scroll
      # remote: krikun98
      # revision: mouse-pr-acceleration
      # revision: mouse-pr
      import: app/west.yml
  self:
    path: config
```
